#include <behaviors.dtsi>
#include <dt-bindings/zmk/keys.h>

#include "name-codes.h"

/ {
    keymap {
        compatible = "zmk, keymap";
        Base_layer {
            label = "default"
            bindings = <
                &kp TAB    &kp Q &kp W &kp E    &kp R     &kp T      &kp Y      &kp U     &kp I     &kp O         &kp P            &kp BACKSPACE
                &kp LCTRL  &kp A &kp S &kp D    &kp F     &kp G      &kp H      &kp J     &kp K     &kp L         &kp SEMICOLON    &kp SINGLE_QUOTE
                &kp LSHIFT &kp Z &kp X &kp C    &kp V     &kp B      &kp N      &kp M     &kp COMMA &kp PERIOD    &kp SLASH        &kp ESCAPE
                &kp LGUI &mo LOWER &kp SPACE  &kp RETURN &mo RAISE &kp RALT 
                >;
        };
    };
}
