#define BD1 &bt BT_SEL 1
#define BD2 &bt BT_SEL 2
#define BD3 &bt BT_SEL 3
#define BD4 &bt BT_SEL 4
#define BD5 &bt BT_SEL 5
#define CBT &bt BT_CLR

#define Bluetooth_layer {
      bindings = <
        &none &none &none &none &none &none   BD1   BD2   BD3   BD4   BD5   CBT
        &none &none &none &none &none &none   &none &none &none &none &none &none
        &none &none &none &none &none &none   &none &none &none &none &none &none
                          &none &none &none   &none &none &none 
      >;
    };
